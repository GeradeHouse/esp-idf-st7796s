## main/Kconfig.projbuild
```kconfig
menu "ST7796S Configuration"

    config GPIO_RANGE_MAX
        int
        default 48

    config WIDTH
        int "SCREEN WIDTH"
        range 0 999
        default 320
        help
            The width resolution of the screen.

    config HEIGHT
        int "SCREEN HEIGHT"
        range 0 999
        default 480
        help
            The height resolution of the screen.

    config OFFSETX
        int "GRAM X OFFSET"
        range 0 99
        default 0
        help
            When your TFT has an offset (X), set it.

    config OFFSETY
        int "GRAM Y OFFSET"
        range 0 99
        default 0
        help
            When your TFT has an offset (Y), set it.

    menu "Parallel Interface Configuration"
        # The OLED display parallel pins listed:
        # GND and VCC are power lines and typically not configurable via GPIO.
        # CD, DC, WR, RD, RST, D0-D7, BL need to be assignable to GPIO pins.

        config CD_GPIO
            int "CD (Chip Select) GPIO number"
            range -1 GPIO_RANGE_MAX
            default -1
            help
                GPIO number (IOxx) for the display Chip Select line.
                When it is -1, it won't be controlled by software.

        config DC_GPIO
            int "DC (Data/Command) GPIO number"
            range 0 GPIO_RANGE_MAX
            default 19
            help
                GPIO number (IOxx) for the Data/Command line.

        config WR_GPIO
            int "WR (Write) GPIO number"
            range 0 GPIO_RANGE_MAX
            default 18
            help
                GPIO number (IOxx) for the Write strobe line.

        config RD_GPIO
            int "RD (Read) GPIO number"
            range -1 GPIO_RANGE_MAX
            default -1
            help
                GPIO number (IOxx) for the Read strobe line.
                When it is -1, read operations are not performed.

        config RST_GPIO
            int "RESET GPIO number"
            range -1 GPIO_RANGE_MAX
            default -1
            help
                GPIO number (IOxx) for the Reset line.
                When it is -1, no hardware reset is performed.

        config D0_GPIO
            int "D0 GPIO number"
            range 0 GPIO_RANGE_MAX
            default 5
            help
                GPIO number (IOxx) for data line D0.

        config D1_GPIO
            int "D1 GPIO number"
            range 0 GPIO_RANGE_MAX
            default 6
            help
                GPIO number (IOxx) for data line D1.

        config D2_GPIO
            int "D2 GPIO number"
            range 0 GPIO_RANGE_MAX
            default 7
            help
                GPIO number (IOxx) for data line D2.

        config D3_GPIO
            int "D3 GPIO number"
            range 0 GPIO_RANGE_MAX
            default 8
            help
                GPIO number (IOxx) for data line D3.

        config D4_GPIO
            int "D4 GPIO number"
            range 0 GPIO_RANGE_MAX
            default 9
            help
                GPIO number (IOxx) for data line D4.

        config D5_GPIO
            int "D5 GPIO number"
            range 0 GPIO_RANGE_MAX
            default 10
            help
                GPIO number (IOxx) for data line D5.

        config D6_GPIO
            int "D6 GPIO number"
            range 0 GPIO_RANGE_MAX
            default 11
            help
                GPIO number (IOxx) for data line D6.

        config D7_GPIO
            int "D7 GPIO number"
            range 0 GPIO_RANGE_MAX
            default 12
            help
                GPIO number (IOxx) for data line D7.

        config BL_GPIO
            int "BACKLIGHT GPIO number"
            range -1 GPIO_RANGE_MAX
            default 14
            help
                GPIO number (IOxx) to control BACKLIGHT.
                When it is -1, no backlight control is performed.

    endmenu

    # NEW PIXEL CLOCK CONFIG
    config PIXEL_CLK_HZ
        int "Pixel Clock Frequency (Hz)"
        range 1000000 40000000
        default 16000000
        help
            The I80 bus pixel clock frequency in Hertz (e.g. 16MHz for ST7796S)

    config INVERSION
        bool "Enable Display Inversion"
        default false
        help
            Enable Display Inversion.

    choice ORIENTATION
        prompt "Display Orientation"
        default ORIENTATION_LANDSCAPE
        help
            Select the orientation of the display.

        config ORIENTATION_LANDSCAPE
            bool "Landscape"
            help
                Landscape orientation.

        config ORIENTATION_PORTRAIT
            bool "Portrait"
            help
                Portrait orientation.

        config ORIENTATION_INVERTED_LANDSCAPE
            bool "Inverted Landscape"
            help
                Inverted Landscape orientation.

        config ORIENTATION_INVERTED_PORTRAIT
            bool "Inverted Portrait"
            help
                Inverted Portrait orientation.
    endchoice

menu "Color Tweaks"

    config GAMMA_R
        string "Gamma Correction for Red Channel"
        default "1.8"
        help
            Set the gamma correction value for the red channel.
            Acceptable values range from 1.0 to 4.0.

    config GAMMA_G
        string "Gamma Correction for Green Channel"
        default "1.8"
        help
            Set the gamma correction value for the green channel.
            Acceptable values range from 1.0 to 4.0.

    config GAMMA_B
        string "Gamma Correction for Blue Channel"
        default "1.8"
        help
            Set the gamma correction value for the blue channel.
            Acceptable values range from 1.0 to 4.0.

    config CONTRAST
        int "Contrast Adjustment (%)"
        range -100 100
        default 0
        help
            Adjust the overall contrast of the display.
            - Positive values increase contrast.
            - Negative values decrease contrast.
            - 0 means no adjustment (default).

    config BRIGHTNESS
        int "Brightness Adjustment (%)"
        range -100 100
        default 0
        help
            Adjust the overall brightness of the display.
            - Positive values increase brightness.
            - Negative values decrease brightness.
            - 0 means no adjustment (default).

    comment "Shadows (Dark Areas)"

    config SHADOWS_CYAN_RED
        int "Shadows Cyan-Red Adjustment (%)"
        range -100 100
        default -10
        help
            Adjusts the Cyan-Red scale for shadows.
            Negative values increase cyan; positive values increase red.

    config SHADOWS_MAGENTA_GREEN
        int "Shadows Magenta-Green Adjustment (%)"
        range -100 100
        default -10
        help
            Adjusts the Magenta-Green scale for shadows.
            Negative values increase magenta; positive values increase green.

    config SHADOWS_YELLOW_BLUE
        int "Shadows Yellow-Blue Adjustment (%)"
        range -100 100
        default -20
        help
            Adjusts the Yellow-Blue scale for shadows.
            Negative values increase yellow; positive values increase blue.

    comment "Midtones (Medium Brightness Areas)"

    config MIDTONES_CYAN_RED
        int "Midtones Cyan-Red Adjustment (%)"
        range -100 100
        default 0
        help
            Adjusts the Cyan-Red scale for midtones.
            Negative values increase cyan; positive values increase red.

    config MIDTONES_MAGENTA_GREEN
        int "Midtones Magenta-Green Adjustment (%)"
        range -100 100
        default 0
        help
            Adjusts the Magenta-Green scale for midtones.
            Negative values increase magenta; positive values increase green.

    config MIDTONES_YELLOW_BLUE
        int "Midtones Yellow-Blue Adjustment (%)"
        range -100 100
        default 0
        help
            Adjusts the Yellow-Blue scale for midtones.
            Negative values increase yellow; positive values increase blue.

    comment "Highlights (Bright Areas)"

    config HIGHLIGHTS_CYAN_RED
        int "Highlights Cyan-Red Adjustment (%)"
        range -100 100
        default 0
        help
            Adjusts the Cyan-Red scale for highlights.
            Negative values increase cyan; positive values increase red.

    config HIGHLIGHTS_MAGENTA_GREEN
        int "Highlights Magenta-Green Adjustment (%)"
        range -100 100
        default 0
        help
            Adjusts the Magenta-Green scale for highlights.
            Negative values increase magenta; positive values increase green.

    config HIGHLIGHTS_YELLOW_BLUE
        int "Highlights Yellow-Blue Adjustment (%)"
        range -100 100
        default 0
        help
            Adjusts the Yellow-Blue scale for highlights.
            Negative values increase yellow; positive values increase blue.

endmenu

endmenu
```

## sdkconfig.defaults
```kconfig
#
# Partition Table
#
CONFIG_PARTITION_TABLE_CUSTOM=y
CONFIG_PARTITION_TABLE_CUSTOM_FILENAME="partitions.csv"
CONFIG_PARTITION_TABLE_FILENAME="partitions.csv"

#
# Sets the default CPU frequency in MHz, where n means the frequency in MHz.
#
CONFIG_ESP_DEFAULT_CPU_FREQ_MHZ=240
```
